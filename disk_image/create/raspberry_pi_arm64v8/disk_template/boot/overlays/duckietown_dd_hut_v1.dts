/dts-v1/;
/plugin/;

/ {
    overlay-name = "Duckietown DD-HUT v1";
    compatible = "brcm,bcm2711";

    fragment@0 {
        // This represents the alias to the parent node (the i2c bus),
        target = <&i2c_arm>;

        __overlay__ {
            #address-cells = <1>;
			#size-cells = <0>;

            mux@77 {
                compatible = "ti,tca9548a", "ti,tca9548", "nxp,pca9548";
                vcc-pullup-supply = <0x4b>;
                status = "okay";
                #address-cells = <0x1>;
                #size-cells = <0x0>;
                vcc-supply = <0x4b>;
                reg = <0x77>;
            };
        };
    };
};